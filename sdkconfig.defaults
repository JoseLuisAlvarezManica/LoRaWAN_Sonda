## sdkconfig.defaults
```kconfig
# Configuración por defecto para Nodo LoRaWAN OTAA + Sensor Modbus
# Este archivo configura automáticamente los parámetros necesarios

# Configuración del sistema
CONFIG_ESP_SYSTEM_EVENT_TASK_STACK_SIZE=4096
CONFIG_ESP_MAIN_TASK_STACK_SIZE=8192

# Configuración de logging
CONFIG_LOG_DEFAULT_LEVEL_INFO=y
CONFIG_LOG_DEFAULT_LEVEL=3

# Configuración SPI
CONFIG_SPI_MASTER_IN_IRAM=y
CONFIG_SPI_MASTER_ISR_IN_IRAM=y

# Configuración UART
CONFIG_UART_ISR_IN_IRAM=y

# Configuración de memoria
CONFIG_ESP_SYSTEM_ALLOW_RTC_FAST_MEM_AS_HEAP=y

# Configuración WiFi (deshabilitada para evitar conflictos con LoRa)
CONFIG_ESP_WIFI_ENABLED=n

# Configuración Bluetooth (deshabilitada para ahorrar memoria)
CONFIG_BT_ENABLED=n

# Habilitar lectura de MAC sin WiFi
CONFIG_ESP_MAC_ADDR_UNIVERSE_WIFI_STA=y


# Optimizaciones de compilación
CONFIG_COMPILER_OPTIMIZATION_SIZE=y
CONFIG_COMPILER_CXX_EXCEPTIONS=n
CONFIG_COMPILER_CXX_RTTI=n

# Configuración de FreeRTOS
CONFIG_FREERTOS_HZ=1000
CONFIG_FREERTOS_ASSERT_ON_UNTESTED_FUNCTION=n

# Configuración de watchdog
CONFIG_ESP_TASK_WDT=y
CONFIG_ESP_TASK_WDT_TIMEOUT_S=10

# Configuración de GPIO
CONFIG_GPIO_ESP32_SUPPORT_SWITCH_SLP_PULL=y
```
